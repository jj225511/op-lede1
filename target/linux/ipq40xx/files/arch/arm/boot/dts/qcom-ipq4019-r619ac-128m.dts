// SPDX-License-Identifier: GPL-2.0-or-later OR MIT

#include "qcom-ipq4019-r619ac.dtsi"

/ {
	model = "竞斗云2.0 128M";
	compatible = "p2w,r619ac-128m";
};

&rootfs_part1 {
	reg = <0x0 0x8000000>;
};

/delete-node/ &rootfs_part2;
